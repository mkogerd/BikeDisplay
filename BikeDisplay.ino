#include <Adafruit_NeoPixel.h>

// Number of pixels per strip
#define NUMPIXELS      17
// LED strip communication pin
#define OUTPUT_PIN     6
// Reed switch input pin for measuring RPS (reads LOW when triggered)
#define INPUT_PIN      4
// Number of radial segments for the image
#define RADSEG         50
// Image data (currently a smiley-face)
const uint8_t image[50][17][3] PROGMEM = {
{{0, 0, 0}, {0, 0, 0}, {0, 0, 0}, {0, 0, 0}, {0, 0, 0}, {0, 0, 0}, {0, 0, 0}, {0, 0, 0}, {0, 0, 0}, {0, 0, 1}, {0, 0, 0}, {0, 0, 0}, {0, 0, 0}, {0, 0, 0}, {0, 0, 0}, {0, 0, 0}, {0, 0, 0}},
{{0, 0, 0}, {0, 0, 0}, {0, 0, 0}, {0, 0, 0}, {0, 0, 0}, {0, 0, 0}, {0, 0, 0}, {0, 0, 0}, {0, 0, 0}, {152, 145, 7}, {156, 148, 7}, {0, 0, 1}, {0, 0, 0}, {0, 0, 0}, {0, 0, 0}, {0, 0, 0}, {0, 0, 0}},
{{0, 0, 0}, {0, 0, 0}, {0, 0, 0}, {0, 0, 0}, {0, 0, 0}, {0, 0, 0}, {0, 0, 0}, {0, 0, 0}, {0, 0, 0}, {219, 209, 5}, {248, 236, 2}, {25, 24, 3}, {0, 0, 0}, {0, 0, 0}, {0, 0, 0}, {0, 0, 0}, {0, 0, 0}},
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{{0, 0, 0}, {0, 0, 0}, {0, 0, 0}, {0, 0, 0}, {0, 0, 0}, {0, 0, 0}, {0, 0, 0}, {0, 0, 0}, {0, 0, 0}, {0, 0, 0}, {0, 0, 0}, {0, 0, 0}, {0, 0, 0}, {0, 0, 0}, {0, 0, 0}, {0, 0, 0}, {0, 0, 0}},
};



// Global Variables
Adafruit_NeoPixel strip = Adafruit_NeoPixel(NUMPIXELS, OUTPUT_PIN, NEO_GRB + NEO_KHZ800);// Create an object for the pixel strip
int delayval;           // Delay between LED updates (in milliseconds)
int radseg;             // Radial segment counter
unsigned long prevtime; // This stores the previous RPS trigger time, used in finding rotation speed
boolean set;            // Indicates if the delay has been set for a rotation (prevents multiple sensor readings on same rotation)

// Debug Variables
boolean debug;          // This enables serial status monitoring (for debugging)
int j;                  // This variable is for alternating-test

void setup() {
  pinMode(INPUT_PIN, INPUT_PULLUP); // This sets up the RPS trigger pin as an pullup-resistor enabled input
  strip.begin();                    // This initializes the LED strip
  radseg = 0;
  prevtime = 0;

  debug = false;                    // This Enable/Disable debug mode
  if(debug){                        // This begins serial output (for debugging)
    Serial.begin(9600);               
    Serial.println("--- Start Serial Monitor ---");
  }
}

void loop() {
  // If sensor is triggered for the first time during a rotation, update refresh-rate and reset image for next rotation
  if (!digitalRead(INPUT_PIN) && !set)
    Wheel_Refresh();
    
  // Allow RPS counter triggering again once the sensor has been passed
  else if(digitalRead(INPUT_PIN)) set = false;

  // display a radial component, delay, and move on to the next radial component until end or a refresh is hit
  if(radseg < RADSEG) {
    SetColor();         // This updates the pixel colors based on the image array
    strip.show();       // This sends the updated pixel color to the hardware.
    radseg++;
    if(delayval < 100)  // Once the RPS falls below .2 rotations per second, stop waiting to draw the picture
      delay(delayval);
  }
  
  // Once the entire image is displayed, turn the display off 
  else ClearLEDs();
}


/*************************************** FUNCTIONS ********************************************/
//------------Wheel_Refresh------------
// This function updates the refresh rate and resets the image
// Input: none
// Output: none
void Wheel_Refresh(void) {
  unsigned long temp;
  if(debug) temp = prevtime;            // hold on to prev time for serial printing (debugging)
  
  set = true;                           // This prevents further sensor reading until the next rotation
  radseg=0;                             // This resets the image
  delayval = (millis()-prevtime)/RADSEG;// This updates the refresh-rate based on current RPS speed
  prevtime = millis();

  if(debug){
    Serial.print("Previous time was ");
    Serial.print(temp);
    Serial.print(", current time is ");
    Serial.print(millis());
    Serial.print(", delay value is ");
    Serial.print(delayval);
    Serial.println(".");
  }
}
//------------SetColor------------
// This function sets the colors of each led (1-20) based on the saved image array
// Input: none (uses global variables)
// Output: none
void SetColor(void){
  for(int led = 0; led < NUMPIXELS; led++){
    strip.setPixelColor(led, pgm_read_byte(&image[radseg][led][1]), pgm_read_byte(&image[radseg][led][2]), pgm_read_byte(&image[radseg][led][3]));
    
    // Display
    if(debug){
      Serial.print("led#: ");
      Serial.print(led);
      Serial.print(", ");
      Serial.print("r = ");
      Serial.print(pgm_read_byte(&image[radseg][led][1]));
      Serial.print(", ");
      Serial.print("g = ");
      Serial.print(pgm_read_byte(&image[radseg][led][2]));
      Serial.print(", ");
      Serial.print("b = ");
      Serial.println(pgm_read_byte(&image[radseg][led][3]));
    }
  }
}
//------------Powerup_DrawPowerups------------
// This function clears all the LEDs and updates them accordingly
// Input: none
// Putput: none
void ClearLEDs(void){
  for(int i=0; i < NUMPIXELS; i++)
    strip.setPixelColor(i, strip.Color(0,0,0)); // this sets each pixel to off
  strip.show();
}
//------------ArrayTest------------
// This function is used by me to test array memory accessing (debug function)
// Input: none
// Output: none
const uint8_t testPM[10] PROGMEM = {9,8,7,6,5,4,3,2,1,0}; // Program memory array to debug access issue
const uint8_t test[10] = {9,8,7,6,5,4,3,2,1,0};
void ArrayTest(void){
  for(int i = 0; i < 10; i++){
    // Display
    if(debug){
      Serial.print("index: ");
      Serial.print(i);
      Serial.print(", ");
      Serial.print("non-PM value = ");
      Serial.print(test[i]);
      Serial.print(", ");
      Serial.print("PROGMEM value = ");
      Serial.print(pgm_read_byte(&testPM[i]));
      Serial.println(". ");
    }
  }
  Serial.println ("Hit a key to continue: ");     // User queued continuation
  while(Serial.available() == 0){}
  Serial.println ("continuing..");

}

